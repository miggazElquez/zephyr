## soc/ti/simplelink/cc23xx/Kconfig
```kconfig
config SOC_SERIES_CC23XX
	bool
	select ARM
	select CPU_CORTEX_M0PLUS

	#select DYNAMIC_INTERRUPTS
	select HAS_TI_CCFG if !BOOTLOADER_MCUBOOT
	select HAS_SEGGER_RTT if ZEPHYR_SEGGER_MODULE
	#select HAS_PM
```

## soc/ti/simplelink/cc23xx/Kconfig.defconfig
```kconfig
config SYS_CLOCK_HW_CYCLES_PER_SEC
	default 48000000

config NUM_IRQS
	default 300  #I don't know the right value, so I just put a big enough value for now.
```

## soc/ti/simplelink/cc23xx/Kconfig.soc
```kconfig
# SPDX-License-Identifier: Apache-2.0
# Copyright (c) 2024, Bootlin

config SOC_SERIES_CC23XX
	bool
	select SOC_FAMILY_TI_SIMPLELINK
	help
	  Enable support for TI SimpleLink CC23xx

config SOC_CC2340R5
	bool
	select SOC_SERIES_CC23XX
	help
	  CC2340R5


config SOC_SERIES
	default "cc23xx" if SOC_SERIES_CC23XX

config SOC
	default "cc2340r5" if SOC_CC2340R5
```
